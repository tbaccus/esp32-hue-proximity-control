## main/Kconfig.projbuild
```kconfig
menu "Philips Hue Proximity Control Settings"
    menu "WiFi Settings"
        config HUE_WIFI_SSID
            string "WiFi SSID"
            default "Example"

        config HUE_WIFI_PASSWORD
            string "WiFi Password"
            default "Password"

        config HUE_WIFI_ADVANCED
            bool "Enable advanced WiFi settings"
            default n

        config HUE_WIFI_SET_BSSID
            bool "Connect to specific AP by BSSID"
            default n
            depends on HUE_WIFI_ADVANCED
            help
                Enable setting of specific AP BSSID to connect to. Helpful when a specific AP is known to have the most
                reliable connection. If one or more APs consistently fail on connection attempts, this can help avoid
                attempting to connect to those APs.

        config HUE_WIFI_BSSID
            string "AP BSSID"
            default "00:00:00:00:00:00"
            depends on HUE_WIFI_SET_BSSID
            help
                BSSID of specific AP to connect to. Helpful when a specific AP is known to have the most reliable
                connection. If one or more APs consistently fail on connection attempts, this can help avoid attempting
                to connect to those APs.

        config HUE_WIFI_SET_IP
            bool "Connect using static IP"
            default n
            depends on HUE_WIFI_ADVANCED

        config HUE_WIFI_IP
            string "Static IP address"
            default "0.0.0.0"
            depends on HUE_WIFI_SET_IP

        config HUE_WIFI_GW
            string "Gateway address"
            default "0.0.0.0"
            depends on HUE_WIFI_SET_IP

        config HUE_WIFI_NM
            string "Netmask"
            default "255.255.255.0"
            depends on HUE_WIFI_SET_IP

        config HUE_WIFI_SET_TIMEOUT
            bool "Enable WiFi timeout period"
            default n
            depends on HUE_WIFI_ADVANCED
            help
                Enable setting of a maximum period of time that esp will attempt to connect to AP before restarting.
                Can be helpful with unstable WiFi connections by reducing wait time with failed connection attempts
                during the association phase.

        config HUE_WIFI_TIMEOUT
            int "WiFi timeout period (seconds) [Must be between 1 and 10 seconds]"
            default 10
            depends on HUE_WIFI_SET_TIMEOUT
            help
                Maximum period of time that esp will attempt to connect to AP before restarting. Can be helpful with
                unstable WiFi connections by reducing wait time with failed connection attempts during the association
                phase. Default: 10s
    endmenu

    menu "Philips Hue Settings"
        config HUE_BRIDGE_IP
            string "Philips Hue Bridge IP Address"
            default "0.0.0.0"
            help
                Visit https://discovery.meethue.com/ to get local bridge IP when connected to the
                same network

        config HUE_BRIDGE_ID
            string "Philips Hue Bridge ID"
            default "0000000000000000"
            help
                Visit https://discovery.meethue.com/ to get local bridge ID when connected to the
                same network

        config HUE_APP_KEY
            string "Philips Hue Application Key"
            default "0000000000000000000000000000000000000000"
            help
                Follow https://developers.meethue.com/develop/hue-api-v2/getting-started to acquire
                application key

        config HUE_LIGHTS_ON_PATH
            string "Philips Hue path to device or group to turn on"
            default "/smart_scene/[smart scene id]"
            help
                Follow https://developers.meethue.com/develop/hue-api-v2/getting-started to acquire
                path and ID

        config HUE_LIGHTS_OFF_PATH
            string "Philips Hue path to device or group to turn off"
            default "/grouped_light/[light group id]"
            help
                Follow https://developers.meethue.com/develop/hue-api-v2/getting-started to acquire
                path and ID
    endmenu
endmenu
```
